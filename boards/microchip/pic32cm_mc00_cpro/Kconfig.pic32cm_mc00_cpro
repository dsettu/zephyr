## boards/microchip/pic32cm_mc00_cpro/Kconfig.pic32cm_mc00_cpro
```kconfig
# Microchp PIC32CM MC00 Family
# Copyright (c) 2024 Microchip Technology Inc. and its subsidiaries.
#
# SPDX-License-Identifier: Apache-2.0

config BOARD_PIC32CM_MC00_CPRO
	select SOC_PIC32CM1216MC00048
```

## boards/microchip/pic32cm_mc00_cpro/board.yml
```yaml
board:
  name: pic32cm_mc00_cpro
  vendor: microchip
  socs:
    - name: pic32cm1216mc00048
```

## boards/microchip/pic32cm_mc00_cpro/pic32cm_mc00_cpro_defconfig
```kconfig
# Copyright (c) 2024 Microchip Technology Inc. and its subsidiaries.
#
# SPDX-License-Identifier: Apache-2.0

CONFIG_BUILD_OUTPUT_HEX=y

CONFIG_CONSOLE=y
CONFIG_SERIAL=y
CONFIG_UART_CONSOLE=y
CONFIG_UART_INTERRUPT_DRIVEN=y
```

## drivers/adc/Kconfig.mchp_u2247
```kconfig
# Microchip ADC configuration options
# Copyright (c) 2024 Microchip Technology Inc. and its subsidiaries.
# SPDX-License-Identifier: Apache-2.0

config ADC_MICROCHIP_ADC_U2247
	bool "Atmel SAM0 series ADC Driver"
	default y
	depends on DT_HAS_MICROCHIP_ADC_U2247_ENABLED
	select ADC_CONFIGURABLE_INPUTS
	help
	  Enable Atmel SAM0 MCU Family Analog-to-Digital Converter (ADC) driver.
```

## drivers/counter/Kconfig.mchp_u2249
```kconfig
# Microchip Counter configuration options
# Copyright (c) 2024 Microchip Technology Inc. and its subsidiaries.
# SPDX-License-Identifier: Apache-2.0

config COUNTER_MICROCHIP_TC_U2249
	bool "Counter Driver"
	default y
	depends on DT_HAS_MICROCHIP_TC_U2249_COUNTER_ENABLED
	help
	  Enable Counter Driver 
```

## drivers/dac/Kconfig.mchp_u2214
```kconfig
# Microchip DAC configuration options
# Copyright (c) 2024 Microchip Technology Inc. and its subsidiaries.
# SPDX-License-Identifier: Apache-2.0


config DAC_MICROCHIP_DAC_U2214
	bool "DAC Driver"
	default y
	depends on DT_HAS_MICROCHIP_DAC_U2214_ENABLED
	help
	  Enables Digital-to-Analog (DAC) driver.
```

## drivers/dma/Kconfig.mchp_u2223
```kconfig
# Microchip DMA configuration options
# Copyright (c) 2024 Microchip Technology Inc. and its subsidiaries.
# SPDX-License-Identifier: Apache-2.0

config DMA_MICROCHIP_DMAC_U2223
	bool "Microchip DMAC driver"
	default y
	depends on DT_HAS_MICROCHIP_DMAC_U2223_ENABLED
	help
	  Enable DMA driver 
```

## drivers/flash/Kconfig.mchp_03929
```kconfig
# Microchip Flash configuration options
# Copyright (c) 2024 Microchip Technology Inc. and its subsidiaries.
# SPDX-License-Identifier: Apache-2.0

menuconfig FLASH_MICROCHIP_NVMCTRL_03929
	bool "Flash driver"
	default y
	depends on DT_HAS_MICROCHIP_NVMCTRL_03929_ENABLED
	select FLASH_HAS_PAGE_LAYOUT
	select FLASH_HAS_DRIVER_ENABLED
	select MPU_ALLOW_FLASH_WRITE if ARM_MPU
	help
	  Enable Flash driver.

config SOC_FLASH_SAM0_EMULATE_BYTE_PAGES
	bool "Emulate byte-sized pages"
	depends on FLASH_MICROCHIP_NVMCTRL_03929
	default y if SOC_SERIES_SAMC20 || \
		     SOC_SERIES_SAMC21
	help
	  Emulate a device with byte-sized pages by doing a
	  read/modify/erase/write.
```

## drivers/gpio/Kconfig.mchp_u2210
```kconfig
# Microchip GPIO configuration options
# Copyright (c) 2024 Microchip Technology Inc. and its subsidiaries.
# SPDX-License-Identifier: Apache-2.0

config GPIO_MICROCHIP_PORT_U2210
	bool "GPIO driver"
	default y
	depends on DT_HAS_MICROCHIP_PORT_U2210_ENABLED
	help
	  Enable support PORT
```

## drivers/i2c/Kconfig.mchp_u2201
```kconfig
# Microchip I2C configuration options
# Copyright (c) 2024 Microchip Technology Inc. and its subsidiaries.
# SPDX-License-Identifier: Apache-2.0

menuconfig I2C_MICROCHIP_SERCOM_U2201
	bool "I2C driver"
	default y
	depends on DT_HAS_MICROCHIP_SERCOM_U2201_I2C_ENABLED
	help
	  Enable I2C driver.

config I2C_SAM0_DMA_DRIVEN
	bool "Enable DMA for I2C"
	depends on I2C_MICROCHIP_SERCOM_U2201
	select DMA
	help
	  This enables DMA driven transactions for the I2C peripheral.
	  DMA driven mode requires fewer interrupts to handle the
	  transaction and ensures that high speed modes are not delayed
	  by data reloading.
```

## drivers/interrupt_controller/Kconfig.mchp_u2254
```kconfig
# Microchip Interrupt Controller configuration options
# Copyright (c) 2024 Microchip Technology Inc. and its subsidiaries.
# SPDX-License-Identifier: Apache-2.0

config INTC_MICROCHIP_EIC_U2254
	bool "External Interrupt Controller (EIC) Driver"
	default y
	depends on DT_HAS_MICROCHIP_EIC_U2254_ENABLED
	help
	  Enable EIC driver.  This is required for GPIO interrupt support.
```

## drivers/pinctrl/Kconfig.mchp_u2210
```kconfig
# Microchip PINCTRL configuration options
# Copyright (c) 2024 Microchip Technology Inc. and its subsidiaries.
# SPDX-License-Identifier: Apache-2.0

config PINCTRL_MICROCHIP_PINCTRL_U2210
	bool "Microchip pin controller driver"
	default y
	depends on DT_HAS_MICROCHIP_PINCTRL_U2210_ENABLED
	help
	  Enable Pin controller driver
```

## drivers/pwm/Kconfig.mchp_u2213
```kconfig
# Microchip PWM configuration options
# Copyright (c) 2024 Microchip Technology Inc. and its subsidiaries.
# SPDX-License-Identifier: Apache-2.0

config PWM_MICROCHIP_TCC_U2213
	bool "PWM Driver"
	default y
	depends on DT_HAS_MICROCHIP_TCC_U2213_PWM_ENABLED
	help
	  Enable PWM driver
```

## drivers/serial/Kconfig.mchp_u2201
```kconfig
# Microchip UART configuration options
# Copyright (c) 2024 Microchip Technology Inc. and its subsidiaries.
# SPDX-License-Identifier: Apache-2.0

config UART_MICROCHIP_SERCOM_U2201
	bool "USART driver"
	default y
	depends on DT_HAS_MICROCHIP_SERCOM_U2201_UART_ENABLED
	select SERIAL_HAS_DRIVER
	select SERIAL_SUPPORT_INTERRUPT
	select UART_SERCOM_U2201_ASYNC if UART_ASYNC_API
	select SERIAL_SUPPORT_ASYNC if DT_HAS_MICROCHIP_DMAC_U2223_ENABLED
	help
	  Enable USART driver

config UART_SERCOM_U2201_ASYNC
	bool "Async UART support"
	depends on DMA_MICROCHIP_DMAC_U2223
	depends on UART_MICROCHIP_SERCOM_U2201
	depends on UART_ASYNC_API
```

## drivers/spi/Kconfig.mchp_u2201
```kconfig
# Microchip SPI configuration options
# Copyright (c) 2024 Microchip Technology Inc. and its subsidiaries.
# SPDX-License-Identifier: Apache-2.0

config SPI_MICROCHIP_SERCOM_U2201
	bool "SPI driver"
	default y
	depends on DT_HAS_MICROCHIP_SERCOM_U2201_SPI_ENABLED
	select DMA if SPI_ASYNC
	help
	  Enable SPI driver.
```

## drivers/timer/Kconfig.mchp_u2250
```kconfig
# Microchip Timer configuration options
# Copyright (c) 2024 Microchip Technology Inc. and its subsidiaries.
# SPDX-License-Identifier: Apache-2.0

config TIMER_MICROCHIP_RTC_U2250
	bool "Timer Driver"
	default y
	depends on DT_HAS_MICROCHIP_RTC_U2250_TIMER_ENABLED
	select TICKLESS_CAPABLE
	help
	  Enable Timer Driver
```

## drivers/watchdog/Kconfig.mchp_u2251
```kconfig
# Microchip Watchdog configuration options
# Copyright (c) 2024 Microchip Technology Inc. and its subsidiaries.
# SPDX-License-Identifier: Apache-2.0

config WDT_MICROCHIP_WDT_U2251
	bool "WDT Driver"
	default y
	depends on DT_HAS_MICROCHIP_WDT_U2251_ENABLED
	select HAS_WDT_DISABLE_AT_BOOT
	help
	  Enable WDT driver.
```

## dts/bindings/arm/microchip,pic32c-id.yml
```yaml
description: |
    For locating the Device ID (serial number) on Microchip PIC32C devices

compatible: "microchip,pic32c-id"

include: base.yaml

properties:
  reg:
    required: true
```

## dts/bindings/arm/microchip,sercom-u2201.yml
```yaml
# Copyright (c) 2024 Microchip Technology Inc. and its subsidiaries.
# SPDX-License-Identifier: Apache-2.0

description: Microchip multi-protocol (UART, SPI, I2C) SERCOM unit

compatible: "microchip,sercom-u2201"

include: base.yaml

properties:
  reg:
    required: true

  interrupts:
    required: true

  clocks:
    required: true
```

## dts/bindings/clock/microchip,gclk-u2122.yml
```yaml
# Copyright (c) 2024 Microchip Technology Inc. and its subsidiaries.
# SPDX-License-Identifier: Apache-2.0

description: Generic Clock Controller (GCLK)

compatible: "microchip,gclk-u2122"

include: [clock-controller.yaml, base.yaml]

properties:
  reg:
    required: true

  "#clock-cells":
    const: 1

clock-cells:
  - periph_ch
```

## dts/bindings/clock/microchip,mclk-u2234.yml
```yaml
# Copyright (c) 2024 Microchip Technology Inc. and its subsidiaries.
# SPDX-License-Identifier: Apache-2.0

description: Main Clock (MCLK)

compatible: "microchip,mclk-u2234"

include: [clock-controller.yaml, base.yaml]

properties:
  reg:
    required: true

  "#clock-cells":
    const: 2

clock-cells:
  - offset
  - bit
```

## dts/bindings/flash_controller/microchip,nvmctrl-03929.yml
```yaml
description: Microchip Non-Volatile Memory Controller (NVMCTRL)

compatible: "microchip,nvmctrl-03929"

include: flash-controller.yaml

properties:
  lock-regions:
    type: int
    required: true
    description: Number of lock regions
```

## dts/bindings/i2c/microchip,sercom-i2c-u2201.yml
```yaml
# Microchip U2201 I2C configuration options
# Copyright (c) 2024 Microchip Technology Inc. and its subsidiaries.
# SPDX-License-Identifier: Apache-2.0

description: Microchip SERCOM I2C node

compatible: "microchip,sercom-i2c-u2201"

include:
  - name: i2c-controller.yaml
  - name: pinctrl-device.yaml

properties:
  reg:
    required: true

  interrupts:
    required: true

  clocks:
    required: true

  clock-names:
    required: true

  dmas:
    description: |
      Optional TX & RX dma specifiers.  Each specifier will have a phandle
      reference to the dmac controller, the channel number, and peripheral
      trigger source.

      For example dmas for TX, RX on SERCOM3
         dmas = <&dmac 0 0xb>, <&dmac 0 0xa>;

  dma-names:
    description: |
      Required if the dmas property exists.  This should be "tx" and "rx"
      to match the dmas property.

      For example
         dma-names = "tx", "rx";
```

## dts/bindings/interrupt-controller/microchip,eic-u2254.yml
```yaml
# Microchip EIC configuration options
# Copyright (c) 2024 Microchip Technology Inc. and its subsidiaries.
# SPDX-License-Identifier: Apache-2.0

description: Microchip External Interrupt Controller

compatible: "microchip,eic-u2254"

include: base.yaml

properties:
  reg:
    required: true

  interrupts:
    required: true
```

## dts/bindings/pwm/microchip,tcc-u2213-pwm.yml
```yaml
# Copyright (c) 2024 Microchip Technology Inc. and its subsidiaries.
# SPDX-License-Identifier: Apache-2.0

description: TCC peripheral in PWM mode

compatible: "microchip,tcc-u2213-pwm"

include:
  - name: base.yaml
  - name: pwm-controller.yaml
  - name: pinctrl-device.yaml

properties:
  reg:
    required: true

  interrupts:
    required: true

  clocks:
    required: true

  clock-names:
    required: true

  channels:
    type: int
    required: true
    description: Number of channels this TCC has
    enum:
      - 2
      - 3
      - 4
      - 6

  counter-size:
    type: int
    required: true
    description: Width of the TCC counter in bits
    enum:
      - 16
      - 24

  prescaler:
    type: int
    required: true
    description: PWM prescaler
    enum:
      - 1
      - 2
      - 4
      - 8
      - 16
      - 64
      - 256
      - 1024

  "#pwm-cells":
    const: 2

pwm-cells:
  - channel
  - period
```
