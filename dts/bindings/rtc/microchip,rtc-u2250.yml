## dts/bindings/rtc/microchip,rtc-u2250.yml
```yaml
# Copyright (c) 2024 Microchip Technology Inc. and its subsidiaries.
# SPDX-License-Identifier: Apache-2.0

description: Microchip RTC

compatible: "microchip,rtc-u2250"

include:
  - name: rtc.yaml
  - name: pinctrl-device.yaml

properties:
  reg:
    required: true

  clock-generator:
    type: int
    description: clock generator index
    required: true
```

## dts/bindings/watchdog/microchip,wdt-u2251.yml
```yaml
description: Microchip watchdog

compatible: "microchip,wdt-u2251"

include: base.yaml

properties:
  reg:
    required: true

  interrupts:
    required: true
```

## soc/microchip/pic32c/Kconfig
```kconfig
# Microchp PIC32CM MC00 Family
# Copyright (c) 2024 Microchip Technology Inc. and its subsidiaries.
#
# SPDX-License-Identifier: Apache-2.0

config SOC_FAMILY_PIC32C
	select HAS_SEGGER_RTT if ZEPHYR_SEGGER_MODULE
	select HAS_PIC32C_HAL

if SOC_FAMILY_PIC32C

rsource "*/Kconfig"

endif # SOC_FAMILY_PIC32C
```

## soc/microchip/pic32c/Kconfig.defconfig
```kconfig
# Microchp PIC32CM MC00 Family
# Copyright (c) 2024 Microchip Technology Inc. and its subsidiaries.
#
# SPDX-License-Identifier: Apache-2.0

if SOC_FAMILY_PIC32C

rsource "*/Kconfig.defconfig"

config GPIO
	default y

config PINCTRL
	default y

config SYS_CLOCK_HW_CYCLES_PER_SEC
	default $(dt_node_int_prop_int,/cpus/cpu@0,clock-frequency)


endif # SOC_FAMILY_PIC32C
```

## soc/microchip/pic32c/Kconfig.soc
```kconfig
# Microchp PIC32CM MC00 Family
# Copyright (c) 2024 Microchip Technology Inc. and its subsidiaries.
#
# SPDX-License-Identifier: Apache-2.0

config SOC_FAMILY_PIC32C
	bool

config SOC_FAMILY
	default "pic32c" if SOC_FAMILY_PIC32C


rsource "*/Kconfig.soc"
```

## soc/microchip/pic32c/pic32cm_mc00/Kconfig
```kconfig
# Microchp PIC32CM MC00 Family
# Copyright (c) 2024 Microchip Technology Inc. and its subsidiaries.
#
# SPDX-License-Identifier: Apache-2.0

config SOC_SERIES_PIC32CM_MC00
	select ARM
	select CPU_CORTEX_M0PLUS
	select CPU_CORTEX_M_HAS_SYSTICK
	select CPU_CORTEX_M_HAS_VTOR
	select CPU_HAS_ARM_MPU
	select PLATFORM_SPECIFIC_INIT
```

## soc/microchip/pic32c/pic32cm_mc00/Kconfig.defconfig
```kconfig
# Microchp PIC32CM MC00 Family
# Copyright (c) 2024 Microchip Technology Inc. and its subsidiaries.
#
# SPDX-License-Identifier: Apache-2.0

if SOC_SERIES_PIC32CM_MC00

config NUM_IRQS
	default 29

endif # SOC_SERIES_PIC32CM_MC00
```

## soc/microchip/pic32c/pic32cm_mc00/Kconfig.soc
```kconfig
# Microchp PIC32CM MC00 Family
# Copyright (c) 2024 Microchip Technology Inc. and its subsidiaries.
#
# SPDX-License-Identifier: Apache-2.0

config SOC_SERIES_PIC32CM_MC00
    bool
	select SOC_FAMILY_PIC32C
    help
      Enable support for Microchip PIC32C Family of Microcontrollers.

config SOC_SERIES
    default "pic32cm_mc00" if SOC_SERIES_PIC32CM_MC00

config SOC_PIC32CM1216MC00032
    bool
    select SOC_SERIES_PIC32CM_MC00

config SOC_PIC32CM1216MC00048
    bool
    select SOC_SERIES_PIC32CM_MC00

config SOC_PIC32CM3204MC00032
    bool
    select SOC_SERIES_PIC32CM_MC00

config SOC_PIC32CM3204MC00048
    bool
    select SOC_SERIES_PIC32CM_MC00

config SOC_PIC32CM6408MC00032
    bool
    select SOC_SERIES_PIC32CM_MC00

config SOC_PIC32CM6408MC00048
    bool
    select SOC_SERIES_PIC32CM_MC00


config SOC
    default "pic32cm1216mc00032" if SOC_PIC32CM1216MC00032
    default "pic32cm1216mc00048" if SOC_PIC32CM1216MC00048
    default "pic32cm3204mc00032" if SOC_PIC32CM3204MC00032
    default "pic32cm3204mc00048" if SOC_PIC32CM3204MC00048
    default "pic32cm6408mc00032" if SOC_PIC32CM6408MC00032
    default "pic32cm6408mc00048" if SOC_PIC32CM6408MC00048
```
